## tests/firmware/rt700-os/boards/wolfssl/wolftrust_rt700_ns/board.yml
```yaml
board:
  name: wolftrust_rt700_ns
  full_name: wolfTrust RT700 Non-secure guest
  vendor: wolfssl
  socs:
  - name: wolftrust_rt700
```

## tests/firmware/rt700-os/soc/wolfssl/wolftrust_rt700/Kconfig
```kconfig
config SOC_WOLFTRUST_RT700
    select ARM
    select CPU_CORTEX_M33
    select CPU_HAS_ARM_SAU
```

## tests/firmware/rt700-os/soc/wolfssl/wolftrust_rt700/Kconfig.defconfig
```kconfig
if SOC_WOLFTRUST_RT700
config NUM_IRQS
    default 128
config SYS_CLOCK_HW_CYCLES_PER_SEC
    default 237500000
endif
```

## tests/firmware/rt700-os/soc/wolfssl/wolftrust_rt700/Kconfig.soc
```kconfig
config SOC_WOLFTRUST_RT700
    bool
config SOC
    default "wolftrust_rt700" if SOC_WOLFTRUST_RT700
```
